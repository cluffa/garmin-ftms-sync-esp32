## boards/heltec-v3/main/Kconfig.projbuild
```kconfig
menu "garmin-ftms-sync"

    config BATTERY_CAL_MV
        int "Battery voltage calibration offset (mV)"
        default 0
        help
            Added to the measured battery millivolts to trim divider/ADC error.
            Read the reported voltage over serial, compare to a multimeter, and
            set the difference here.

    config DISPLAY_IMPERIAL
        bool "Display imperial units (mph / miles)"
        default n
        help
            When enabled, the home screen shows speed in mph and distance in
            miles instead of km/h and km. (Incline stays a percentage.)
            Set via `idf.py menuconfig` or in sdkconfig.defaults.

endmenu
```

## boards/heltec-v3/sdkconfig.defaults
```kconfig
CONFIG_BT_ENABLED=y
CONFIG_BT_NIMBLE_ENABLED=y
CONFIG_BT_NIMBLE_ROLE_CENTRAL=y
CONFIG_BT_NIMBLE_ROLE_PERIPHERAL=y
CONFIG_BT_NIMBLE_MAX_CONNECTIONS=3

# Show imperial units (mph/mi) on the OLED
CONFIG_DISPLAY_IMPERIAL=y
```

## boards/xiao-c6/main/Kconfig.projbuild
```kconfig
menu "garmin-ftms-sync"
    # No board-specific config needed for XIAO ESP32-C6 (no display/battery ADC)
endmenu
```
